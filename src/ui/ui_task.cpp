#include "ui_task.h"
#include "../../include/LGFX_Config.h"
#include "../config/sys_config.h"
#include "../system/sys_mgr.h"
#include "../managers/input_mgr.h"
#include "freertos/FreeRTOS.h"
#include "freertos/task.h"
#include "esp_log.h"

#include "apps/IApp.h"
#include "apps/App_Grid.h"
#include "apps/App_OTA.h"
#include "apps/App_Settings.h"
#include "apps/App_Torch.h"
#include "apps/App_GameStore.h"
#include "apps/App_NES.h"
#include "apps/App_HackStore.h"
#include "apps/App_ClockWeather.h"
#include "apps/App_Pomodoro.h"
#include "apps/App_Pentest.h"
#include "theme_mgr.h"
#include "../utils/color_utils.h"
#include "nvs_flash.h"
#include "nvs.h"
#include "../services/idle_mgr.h"

// RGB565 icon arrays — generated by convert_icons.py (pre-build step).
// Each file exposes: static const uint16_t icon_<name>[4096]
#include "../assets/icons/ota.h"
#include "../assets/icons/settings.h"
#include "../assets/icons/torch.h"
#include "../assets/icons/games.h"
#include "../assets/icons/app_store.h"
#include "../assets/icons/weather.h"
#include "../assets/icons/pomodoro.h"
#include "../assets/icons/deauther.h"

static const char *TAG = "UI_TASK";

// NOTE: The panel's intrinsic ~4px vertical offset is corrected at the source
// via cfg.offset_x = 4 in LGFX_Config.h (it zeroes LovyanGFX's _rowstart in
// rotation 1). The framebuffer therefore maps 1:1 to the glass — push at (0,0),
// no Y compensation, so neither the top nor the bottom rows are clipped.

static LGFX_ESP32S3_ST7735 tft;
static LGFX_Sprite canvas(&tft);

static uint8_t current_brightness = 255;

void ui_set_brightness(uint8_t val) {
    if (val < 10) val = 10;
    current_brightness = val;
    tft.setBrightness(val);

    nvs_handle_t handle;
    if (nvs_open("ui_cfg", NVS_READWRITE, &handle) == ESP_OK) {
        nvs_set_u8(handle, "brightness", val);
        nvs_commit(handle);
        nvs_close(handle);
    }
}

uint8_t ui_get_brightness(void) {
    return current_brightness;
}

static App_Grid         app_grid;
static App_OTA          app_ota;
static App_Settings     app_settings;
static App_Torch        app_torch;
static App_GameStore    app_gamestore;
static App_HackStore    app_hackstore;
static App_ClockWeather app_clockweather;
static App_Pomodoro     app_pomodoro;
static App_Pentest      app_pentest;

static IApp* current_app = nullptr;

uint8_t ui_get_launcher_theme(void) {
    return (uint8_t)app_grid.getLauncherTheme();
}

void ui_set_launcher_theme(uint8_t theme) {
    app_grid.setLauncherTheme((launcher_theme_t)theme);
}


static void _run_slide_transition(LGFX_Sprite* old_snap, LGFX_Sprite* new_snap) {
    const int SLIDE_FRAMES = 15;
    const int W = tft.width();
    TickType_t last_wake = xTaskGetTickCount();

    for (int i = 1; i <= SLIDE_FRAMES; i++) {
        float t = (float)i / (float)SLIDE_FRAMES;
        
        // Cubic ease-out: f(t) = 1 - (1-t)^3
        float inv = 1.0f - t;
        float eased = 1.0f - (inv * inv * inv);
        
        int offset = (int)(eased * (float)W);

        // Clear canvas with background color first to ensure no ghosting in edges
        canvas.fillSprite(theme_get_bg());

        // Parallax effect: old frame slides out at half speed drawn onto canvas (0-based Y offset)
        int old_x = -(offset / 2);
        old_snap->pushSprite(&canvas, old_x, 0);
        
        // Subtle edge shadow/separator drawn onto canvas
        if (offset < W && W - offset > 0) {
            canvas.drawFastVLine(W - offset - 1, 0, canvas.height(),
                color_blend(theme_get_bg(), theme_get_text_dim(), 0.4f));
            if (W - offset > 1) {
                canvas.drawFastVLine(W - offset - 2, 0, canvas.height(),
                    color_blend(theme_get_bg(), theme_get_text_dim(), 0.2f));
            }
        }

        // Draw new frame sliding in over the old one onto canvas (0-based Y offset)
        new_snap->pushSprite(&canvas, W - offset, 0);

        // Push the composite frame to the panel (1:1 — vertical offset is
        // handled by cfg.offset_x in LGFX_Config.h, not here).
        canvas.pushSprite(&tft, 0, 0);

        vTaskDelayUntil(&last_wake, pdMS_TO_TICKS(20)); // ~50fps logic update
    }
}

// ─── App switch with slide + safe dynamic-app deletion ────────────────────
void switch_to_app(IApp* next_app) {
    if (!next_app) return;

    // ── Capture old frame for the slide animation ────────────────────────
    // Allocate snapshot sprites in PSRAM to avoid touching internal SRAM.
    LGFX_Sprite old_snap(&tft);
    LGFX_Sprite new_snap(&tft);
    old_snap.setPsram(true);
    new_snap.setPsram(true);
    old_snap.setColorDepth(16);
    new_snap.setColorDepth(16);
    bool old_snap_ok = old_snap.createSprite(tft.width(), tft.height());
    bool new_snap_ok = new_snap.createSprite(tft.width(), tft.height());
    bool transition_ok = old_snap_ok && new_snap_ok;
    if (!transition_ok) {
        if (old_snap_ok) old_snap.deleteSprite();
        if (new_snap_ok) new_snap.deleteSprite();
        ESP_LOGW(TAG, "Skipping app transition animation due to sprite allocation failure");
    }

    // Render current state into old_snap
    if (transition_ok && current_app) {
        current_app->render(&old_snap);
    }

    // ── Exit current app ─────────────────────────────────────────────────
    IApp* old_app = current_app;
    if (old_app) {
        old_app->exit();
    }

    // ── Bring in the new app ─────────────────────────────────────────────
    current_app = next_app;
    current_app->init();

    // ── Render first frame of new app into new_snap ──────────────────────
    if (transition_ok) {
        theme_update();  // Ensure theme interpolation is current
        current_app->render(&new_snap);

        // Play the slide animation
        _run_slide_transition(&old_snap, &new_snap);

        old_snap.deleteSprite();
        new_snap.deleteSprite();
    }

    // ── Delete dynamic (heap-allocated) old app AFTER transition is done ─
    // This is the fix for the App_NES SRAM leak: safe because exit() has
    // already run, the new app is fully initialised, and the transition
    // sprites that referenced old_app's pixels have already been pushed.
    if (old_app && old_app->isDynamic()) {
        ESP_LOGI(TAG, "Deleting dynamic app instance (leak fix)");
        delete old_app;
    }
}

void switch_to_grid() {
    switch_to_app(&app_grid);
}

static void ui_task_runner(void *arg) {
    ESP_LOGI(TAG, "UI Task Started (Event-Driven Architecture)");

    tft.init();
    tft.setRotation(1);

    nvs_handle_t handle;
    if (nvs_open("ui_cfg", NVS_READONLY, &handle) == ESP_OK) {
        nvs_get_u8(handle, "brightness", &current_brightness);
        nvs_close(handle);
    }
    tft.setBrightness(current_brightness);

    canvas.setColorDepth(16);
    canvas.setPsram(true);
    if (!canvas.createSprite(tft.width(), tft.height())) {
        ESP_LOGE(TAG, "Failed to create main UI canvas");
        vTaskDelete(nullptr);
        return;
    }

    theme_init();

    app_grid.registerApp("OTA System",  icon_ota,       &app_ota,         "Firmware update via WiFi",            "System");
    app_grid.registerApp("Torch",       icon_torch,     &app_torch,       "Flashlight with adjustable modes",    "Tools");
    app_grid.registerApp("Settings",    icon_settings,  &app_settings,    "System configuration and preferences", "System");
    app_grid.registerApp("Game Store",  icon_games,     &app_gamestore,   "Browse and download NES ROMs",        "Entertainment");
    app_grid.registerApp("Hack Store",  icon_app_store, &app_hackstore,   "Community scripts and extensions",    "Development");
    app_grid.registerApp("Clock",       icon_weather,   &app_clockweather,"Time, weather, and forecast",         "Utilities");
    app_grid.registerApp("Pomodoro",    icon_pomodoro,  &app_pomodoro,    "Focus timer and productivity tool",   "Productivity");
    app_grid.registerApp("Pentest",     icon_deauther,  &app_pentest,     "WiFi/BLE security auditing",          "Security");

    // Use a direct init for the first launch — no slide needed at boot
    current_app = &app_grid;
    current_app->init();

    const TickType_t xFrameTime = pdMS_TO_TICKS(25); // 40 FPS target
    TickType_t xLastWakeTime = xTaskGetTickCount();

    while (1) {
        // Process input events (non-blocking)
        input_event_t ev = input_mgr_get_event();
        if (ev != BTN_NONE) {
            idle_mgr_feed();
            ESP_LOGD(TAG, "DISPATCH ev=%d to %s", ev,
                current_app ? "app" : "null");
        }
        if (current_app) {
            current_app->handleInput(ev);
        }

        // Update animations
        theme_update();
        if (current_app) {
            current_app->loop();
        }

        // Render
        if (current_app) {
            current_app->render(&canvas);
        }

        // Idle countdown overlay with enhanced visuals
        if (idle_mgr_get_state() == IDLE_STATE_COUNTDOWN) {
            int rem = idle_mgr_get_countdown_remaining();
            int w = canvas.width();
            int h = canvas.height();

            int bw = w * 7 / 8;
            int bh = h / 2;
            int bx = (w - bw) / 2;
            int by = (h - bh) / 2;

            float pulse = sinf((float)(esp_timer_get_time() / 500000));
            uint16_t warning_color = (rem <= 3) ? theme_get_fail() :
                                     (rem <= 6) ? theme_get_accent() :
                                     theme_get_accent();
            
            canvas.fillRoundRect(bx - 2, by - 2, bw + 4, bh + 4, 10,
                color_blend(warning_color, theme_get_bg(), 0.08f + pulse * 0.04f));
            
            canvas.fillRoundRect(bx, by, bw, bh, 8,
                color_blend(theme_get_bg(), theme_get_bg(), 0.85f));
            
            canvas.drawRoundRect(bx, by, bw, bh, 8, 
                color_blend(warning_color, theme_get_text(), 0.75f + pulse * 0.25f));
            canvas.drawRoundRect(bx + 1, by + 1, bw - 2, bh - 2, 7,
                color_blend(warning_color, theme_get_bg(), 0.25f));

            int bar_w = w / 26;
            int bar_max_h = bh - 16;
            int bar_x = bx + 10;
            int bar_y = by + 8;

            canvas.fillRoundRect(bar_x, bar_y, bar_w, bar_max_h, 3,
                color_blend(theme_get_text_dim(), theme_get_bg(), 0.15f));
            canvas.drawRoundRect(bar_x, bar_y, bar_w, bar_max_h, 3,
                color_blend(theme_get_text_dim(), theme_get_bg(), 0.35f));

            int fill_h = (int)(bar_max_h * (rem / 10.0f));
            if (fill_h > 0) {
                for (int i = 0; i < fill_h; i += 2) {
                    float gradient = (float)i / (float)fill_h;
                    uint16_t seg_color = color_blend(warning_color, 
                        theme_get_accent(), gradient * 0.4f);
                    canvas.drawFastHLine(bar_x + 2, bar_y + bar_max_h - i - 1, 
                        bar_w - 4, seg_color);
                }
                canvas.fillRoundRect(bar_x + 2, bar_y + bar_max_h - fill_h, 
                    bar_w - 4, 2, 1, theme_get_text());
            }

            int text_x = bar_x + bar_w + 8;

            canvas.setTextDatum(textdatum_t::middle_left);
            canvas.setFont(&fonts::Font2);
            char buf[16];
            snprintf(buf, sizeof(buf), "%ds", rem);
            
            if (rem <= 3) {
                int shake = (int)(pulse * 2);
                canvas.setTextColor(color_blend(theme_get_fail(), 
                    theme_get_accent(), pulse * 0.5f + 0.5f));
                canvas.drawString(buf, text_x + shake, bar_y + 6);
            } else {
                canvas.setTextColor(theme_get_text());
                canvas.drawString(buf, text_x, bar_y + 6);
            }

            canvas.setFont(&fonts::Font0);
            canvas.setTextColor(warning_color);
            canvas.drawString("SLEEPING SOON", text_x, bar_y + 20);

            canvas.setTextColor(color_blend(theme_get_text(), theme_get_bg(), 0.6f));
            canvas.drawString("Press any key", text_x, bar_y + 32);
        }

        canvas.pushSprite(0, 0);

        // Precise frame timing
        vTaskDelayUntil(&xLastWakeTime, xFrameTime);
    }
}

extern "C" void ui_task_init(void) {
    xTaskCreatePinnedToCore(
        ui_task_runner,
        "ui_task",
        8192,
        NULL,
        5,
        NULL,
        1
    );
}
